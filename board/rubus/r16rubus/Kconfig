## board/rubus/r16rubus/Kconfig
```kconfig
if TARGET_R16RUBUS

config SYS_BOARD
	default "r16rubus"

config SYS_VENDOR
	default "rubus"

config SYS_CONFIG_NAME
	default "r16rubus"

endif
```

## configs/r16dlrubus_defconfig
```kconfig
CONFIG_ARM=y
CONFIG_ARCH_MX6=y
CONFIG_TARGET_R16RUBUS=y
CONFIG_SYS_EXTRA_OPTIONS="IMX_CONFIG=board/rubus/r16rubus/r16dlrubus.cfg,MX6DL"
# CONFIG_CMD_IMLS is not set
# CONFIG_CMD_FLASH is not set
CONFIG_SPI_FLASH=y
```
